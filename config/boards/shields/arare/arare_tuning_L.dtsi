/* arare チューニング（左手）: 左エンコーダ＋ジョイスティック（受け口）
 *
 * このファイルは arare Studio の「設定」パネルが生成するテキストでまるごと差し替える運用。
 * 既定値 = 現状維持。
 */

/* 左エンコーダ（EC12・縦）の分解能と感度 */
&left_encoder {
    /* 1クリック＝1回にする値（2026-09-22 実測）。この EC12 は1クリックで信号が4回変化する
     * （24クリック×4＝96 変化/回転）。1変化＝360/steps 度で、右手（central）の
     * triggers-per-rotation=10 なら 36 度ごとに1回出るので、4×(360/steps)=36 → steps=40。
     * 12 のままだと1クリックで約3回出ていた。
     * ★arare Studio の既定は 12 なので、Studio で作り直すと戻る。Studio 側で 40 にすること。 */
    steps = <40>;
};

&sensors {
    triggers-per-rotation = <10>;
};

/* ジョイスティックを付けている構成。
 * 電池ドライバを oversampling=0 の arare 版へ差し替えて SAADC の停止を避ける。
 * 理由と代償は arare_L.conf のコメントを参照。
 * ★付けない構成では arare Studio がこのincludeを出さず、代わりに
 *   &joystick / &joystick_split を disabled にする。 */
#include "arare_saadc_fix.dtsi"

/* ---- ジョイスティック（アナログXY）----
 * 中点・振れ幅・軸の向きは実測済みで、arare_L.overlay に置いてある（Studio の再生成で消えないように）。
 * ここで変えるのは中央の遊びだけ。
 *   mv-deadzone: 手を離しても勝手に反応するなら大きく（uint8_t 格納なので 255 以下）。
 *   実測では離したときの位置が中点から最大 ±65〜76 mV ずれる。100 なら切り捨て分の 70 と合わせて
 *   ±170 mV まで無反応で、90 mV 以上の余裕がある（arare Studio の既定 60 だと余裕は 50 mV 前後）。
 */
&joy_x {
    mv-deadzone = <100>;
};

&joy_y {
    mv-deadzone = <100>;
};

## Kconfig
```kconfig
DT_COMPAT_ARARE_BATTERY_VOLTAGE_DIVIDER := arare,battery-voltage-divider

# arare 独自設定

menuconfig ARARE_BATTERY_LED
    bool "arare: 電池残量をマイコンのLEDで知らせる"
    depends on ZMK_BATTERY_REPORTING
    help
      XIAO nRF52840 内蔵のRGB LEDで電池残量を色で示す。
      常時点灯はせず、起動直後・スリープ復帰時に短く点灯し、
      残量が少ないときだけ定期的に赤く点滅して充電を促す。
      USB接続中は残量色を点灯したままにする。

if ARARE_BATTERY_LED

config ARARE_BATTERY_LED_GOOD_PCT
    int "この値以上を緑にする(%)"
    default 60

config ARARE_BATTERY_LED_LOW_PCT
    int "この値以下で充電を促す(%)"
    default 20

config ARARE_BATTERY_LED_CRITICAL_PCT
    int "この値以下は警告を強める(%)"
    default 10

config ARARE_BATTERY_LED_GLANCE_MS
    int "起動時・復帰時に残量色を点灯する時間(ミリ秒)"
    default 1500

config ARARE_BATTERY_LED_WARN_INTERVAL_SEC
    int "残量が少ないときの警告間隔(秒)"
    default 300

config ARARE_BATTERY_LED_CRITICAL_INTERVAL_SEC
    int "残量が危険域のときの警告間隔(秒)"
    default 120

endif # ARARE_BATTERY_LED

# arare 独自の電池電圧ドライバ（SAADCのオーバーサンプリングを無効化した版）
# デバイスツリーに arare,battery-voltage-divider のノードがあれば自動で有効になる。
# ジョイスティックのアナログXYと電池計測を共存させるためのもの。理由は arare_L.conf 参照。
config ARARE_BATTERY_VOLTAGE_DIVIDER
    bool
    default $(dt_compat_enabled,$(DT_COMPAT_ARARE_BATTERY_VOLTAGE_DIVIDER))
    select ADC
    select ZMK_BATTERY
    depends on SENSOR
    help
      ZMK本家の battery_voltage_divider と同一だが oversampling=0。
      本家を fork せずに済ませるため設定リポジトリ側にドライバを持つ。
```

## config/boards/shields/arare/Kconfig.shield
```kconfig
config SHIELD_ARARE_L
	def_bool $(shields_list_contains,arare_L)

config SHIELD_ARARE_R
	def_bool $(shields_list_contains,arare_R)
```

## config/west.yml
```yaml
manifest:
  remotes:
    - name: zmkfirmware
      url-base: https://github.com/zmkfirmware
    - name: sekigon-gonnoc
      url-base: https://github.com/sekigon-gonnoc
    - name: nuovotaka
      url-base: https://github.com/nuovotaka
    - name: t-ogura
      url-base: https://github.com/t-ogura
    # ジョイスティック（アナログXY）用
    - name: badjeff
      url-base: https://github.com/badjeff
    # 上流の不具合を直したフォーク（arare 自身のアカウント）
    - name: amearare54
      url-base: https://github.com/amearare54
  projects:
    - name: zmk
      remote: zmkfirmware
      revision: v0.3.0
      import: app/west.yml
    # PAW3222 trackball driver.
    # torabo-tsuki branch = main + nRF52 SDIO connect/disconnect power saving
    # (supports spi0/spi1 node labels only — arare_R uses spi1)
    - name: zmk-driver-paw3222
      remote: sekigon-gonnoc
      revision: torabo-tsuki
      path: modules/zmk-driver-paw3222
    # ポインタ加速 input processor（PAW3222で実機テスト済み・ZMK v0.3.0対応）
    - name: zmk-pointing-acceleration-alpha
      remote: nuovotaka
      revision: 780dfcd6b796063367893ff41e233773e12fb07c
      path: modules/zmk-pointing-acceleration
    # ステータスBLEアドバタイズ（ArareHUDレイヤー表示用。v2.2.3タグのSHA。
    # central=右のみ送信・ホスト接続中も継続。manufacturer data 26B: [6]=active_layer）
    - name: prospector-zmk-module
      remote: t-ogura
      revision: 72a71aeea816eb0f86ffc5b108b267076ce5f0af
      path: modules/prospector-zmk-module
    # 左手ジョイスティックのアナログXY。ADCの複数chを1つのinputイベントにまとめる。
    # 作者本人がREADMEで「ポーリング方式のため消費電力が高く無線ビルドには非推奨」と警告しているが、
    # ユーザーが消費電力を承知のうえで採用を決定（2026-09-05）。
    # ZMKバージョン対応の記載はリポジトリに無く、v0.3.0との互換は依存API
    # （input_report / sensor_driver_api / ADC_DT_SPEC_GET_BY_IDX）のソース照合による間接確認のみ。
    # ★2026-09-22 フォーク版に切り替え。上流 2684f22 に1行の修正を足したもの（branch: arare-fix-uint8-loop）。
    #   analog_input.c の `for (uint8_t i = len - 1; i >= 0; i--)` は i >= 0 が常に真で、
    #   全チャネルが前回と同じ（スティック静止）ときに配列の外を読み続け、永久に抜けないことがある。
    #   左手でこれを踏むと左右が繋がらなかった（ジョイスティックを外すと 20/20 で繋がる）。
    #   上流 main でも未修正（2026-09-22 時点）。
    - name: zmk-analog-input-driver
      remote: amearare54
      revision: 81f22641ca430040363b4d6dd569555cb6a2c260
      path: modules/zmk-analog-input-driver
  self:
    path: config
```

## dts/bindings/input_processor/arare,input-processor-gesture.yaml
```yaml
# arare 独自: ジョイスティックを倒した方向でビヘイビアを1回だけ発火させる入力プロセッサ
#
# トラックパッドの3本指スワイプ相当を親指のスティックで行うためのもの。
# 相対移動(REL_X/REL_Y)を方向ごとに積算し、しきい値を超えた瞬間にタップを1回送る。
# 1回はじく＝1回。中央へ戻す（イベントが reset-ms 途切れる）と次が出る。
description: Fire a behavior once per directional flick of an analog stick

compatible: "arare,input-processor-gesture"

include: ip_zero_param.yaml

properties:
  threshold:
    type: int
    default: 40
    description: この量だけ積算したら発火する（相対移動の合計）
  reset-ms:
    type: int
    default: 100
    description: >
      この時間、大きな動き（|値| > min-value）が来なければ、中央へ戻したとみなして再武装する。
      倒している間は約30msごとにレポートが来る。200 だと素早く続けてはじいた2回目以降を
      取りこぼした（実測ログで17回中9回）。80 を切ると倒したままの間に再武装して2回出る恐れがある。
      arare Studio のレイヤー別ノード（joy_gesture_N）は指定しないので、この既定値が効く
  tap-ms:
    type: int
    default: 20
    description: 押してから離すまでの時間
  repeat-ms:
    type: int
    default: 0
    description: >
      同じ向きに倒し続けたとき、この間隔で繰り返す。0 = 繰り返さない（1回はじく＝1回）。
      上（Mission Control）のように開閉が交互になる操作があるので、既定は 0
  min-value:
    type: int
    default: 6
    description: >
      1回のイベントの |値| がこれ以下なら、中央付近の揺れ・中点のずれとして無視する（積算もしない）。
      6 は 1サンプル2（中点からおよそ デッドゾーン+210mV まで）× 1レポート3サンプル。
      はっきりはじくと1レポートで 15〜36 になる
  bindings:
    type: phandle-array
    required: true
    description: 上・下・左・右の順に4つ指定する
```
